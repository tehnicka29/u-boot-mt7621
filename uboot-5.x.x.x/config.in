## uboot-5.x.x.x/config.in
```kconfig
string 'Cross Compiler Path' CONFIG_CROSS_COMPILER_PATH  ${HOME}/toolchain/mips-2021.02/bin

comment ""

mainmenu_name 'Uboot Configuration'

define_bool CONFIG_LZMA y
define_bool CONFIG_GZIP n

define_bool CONFIG_QMALLOC y

define_bool RALINK_MDIO_ACCESS_FUN y
define_bool RALINK_EPHY_INIT y

define_hex TEXT_BASE 0xBFC00000

define_string CONFIG_BOOTCOMMAND "tftp"
define_string CONFIG_BOOTFILE "firmware.bin"

define_bool CFG_ENV_IS_IN_SPI y

bool "Debug Build" DEBUG_BUILD n
bool "Use MIPS16 ASE" CONFIG_MIPS16_ASE n
bool "Use LTO (unsafe with mips16!)" CONFIG_LTO n

choice 'UART baudrate'  "115200 CONFIG_BAUDRATE_115200 \
                         57600 CONFIG_BAUDRATE_57600
                         " "115200"

#########################################################################################3
# MT7621
#########################################################################################3

comment "SPI Flash Configuration ---"

#-----------------------
# MT7621 FLASH
#-----------------------

define_bool ON_BOARD_SPI_FLASH_COMPONENT y

choice 'Default Flash Size' "4MB ON_BOARD_8M_FLASH_COMPONENT \
                     8MB ON_BOARD_8M_FLASH_COMPONENT \
                     16MB ON_BOARD_16M_FLASH_COMPONENT \
                     32MB ON_BOARD_32M_FLASH_COMPONENT
                     " 16MB

#if [ "$ON_BOARD_SPI_FLASH_COMPONENT" = "y" ]; then
	bool "Use 50MHz clock" SPI_FAST_CLOCK n
	bool "Use fast read mode" SPI_FLASH_READ_FAST y
	bool "Use double read mode" SPI_FLASH_READ_DOR y
	bool "Use quad read mode" SPI_FLASH_READ_QOR y
#fi

comment ""

bool   "Default Boot Environment"   CFG_ENV_IS_NOWHERE y
int    "Boot Delay"                 CONFIG_BOOTDELAY   3
string "Boot Arguments"             CONFIG_BOOTARGS
string "Server IP"                  CONFIG_SERVERIP    "192.168.1.2"
string "Netmask"                    CONFIG_NETMASK     "255.255.255.0"
string "Device IP"                  CONFIG_IPADDR      "192.168.1.1"
string "Default MAC Address"        CONFIG_ETHADDR     "28:D1:27:EA:4F:47"
hex    'Factory MAC Address Offset' GMAC0_OFFSET       FA0008

comment ""

choice 'CPU Frequency' "900Mhz MT7621_CPU_900MHZ \
			880Mhz MT7621_CPU_880MHZ \
			875Mhz MT7621_CPU_875MHZ \
			800Mhz MT7621_CPU_800MHZ \
			500Mhz MT7621_CPU_500MHZ \
			50Mhz MT7621_CPU_50MHZ
			" "880Mhz"

if [ "$MT7621_CPU_900MHZ" = "y" ]; then
    define_hex  MT7621_CPU_FREQUENCY    384
fi
if [ "$MT7621_CPU_880MHZ" = "y" ]; then
    define_hex  MT7621_CPU_FREQUENCY    370
fi
if [ "$MT7621_CPU_875MHZ" = "y" ]; then
    define_hex  MT7621_CPU_FREQUENCY    36B
fi
if [ "$MT7621_CPU_800MHZ" = "y" ]; then
    define_hex  MT7621_CPU_FREQUENCY    320
fi
if [ "$MT7621_CPU_500MHZ" = "y" ]; then
    define_hex  MT7621_CPU_FREQUENCY    1F4
fi
if [ "$MT7621_CPU_50MHZ" = "y" ]; then
    define_hex  MT7621_CPU_FREQUENCY    32
fi

define_bool ON_BOARD_DDR_WIDTH_16 y
define_bool ON_BOARD_16BIT_DRAM_BUS y

choice 'DDR Component' "512Mb  ON_BOARD_512M_DRAM_COMPONENT  \
			1024Mb ON_BOARD_1024M_DRAM_COMPONENT \
			1024Mb-KGD ON_BOARD_1024M_KGD_DRAM_COMPONENT \
			2048Mb ON_BOARD_2048M_DRAM_COMPONENT \
			4096Mb ON_BOARD_4096M_DRAM_COMPONENT
			" "1024Mb-KGD"

choice 'DRAM Speed'    "1200Mhz MT7621_DDR_1200MHZ \
			1066Mhz MT7621_DDR_1066MHZ \
			800Mhz MT7621_DDR_800MHZ \
			400Mhz MT7621_DDR_400MHZ
			" "1200Mhz"

#================
#1PLL=10, 20, 30
#3PLL=11, 21, 31
#================
if [ "$MT7621_DDR_1200MHZ" = "y" ]; then
    define_hex  MT7621_DDR_SPEED    11
fi
if [ "$MT7621_DDR_1066MHZ" = "y" ]; then
    define_hex  MT7621_DDR_SPEED    21
fi
if [ "$MT7621_DDR_800MHZ" = "y" ]; then
    define_hex  MT7621_DDR_SPEED    31
fi
if [ "$MT7621_DDR_400MHZ" = "y" ]; then
    define_hex  MT7621_DDR_SPEED    41
fi

#-----------------------
# MT7621 Option
#-----------------------
comment ""

define_bool RALINK_DUAL_VPE_FUN y

bool "Dual Core Support" RALINK_DUAL_CORE_FUN y

bool "DDR ACTiming Setting" DDR_ACT_SETTING
if [ "$DDR_ACT_SETTING" = "y" ]; then
	choice 'DDR Chip' "\
	DDR3-128MB DEFAULT_DDR3_1024M \
	DDR3-128MB-KGD DEFAULT_DDR3_1024M_KGD \
	DDR3-256MB DEFAULT_DDR3_2048M \
	DDR3-512MB DEFAULT_DDR3_4096M
	" "DDR3-128MB-KGD"
    if [ "$DEFAULT_DDR3_1024M" = "y" ]; then
    	define_string DDR_CHIP DEFAULT_DDR3_1024M
    fi
    if [ "$DEFAULT_DDR3_1024M_KGD" = "y" ]; then
	define_string DDR_CHIP DEFAULT_DDR3_1024M_KGD
    fi
    if [ "$DEFAULT_DDR3_2048M" = "y" ]; then
	define_string DDR_CHIP DEFAULT_DDR3_2048M
    fi
    if [ "$DEFAULT_DDR3_4096M" = "y" ]; then
    	define_string DDR_CHIP DEFAULT_DDR3_4096M
    fi
fi

bool "Partition LAN/WAN" LAN_WAN_PARTITION n
if [ "$LAN_WAN_PARTITION" = "y" ]; then
	choice 'LAN/WAN Port Mapping at Boot'	"LLLL/W RALINK_PVLAN_LLLLW \
						LLLL/X RALINK_PVLAN_LLLLX \
						LLL/WW RALINK_PVLAN_LLLWW \
						LLL/XX RALINK_PVLAN_LLLXX
						"
fi

bool "Enable all Ethernet PHY" EPHY_LINK_UP n

##################################################################################################
comment ""
bool 'HTTPD server'			  HTTPD_SUPPORT		y
bool 'TFTP'				  TFTP_SUPPORT		y
bool 'BOOTP/DHCP'			  BOOTP_SUPPORT		n
bool 'SNTP'				  SNTP_SUPPORT		n
bool 'RARP'				  RARP_SUPPORT		n
bool 'U-Boot CLI'			  RALINK_CMDLINE	y
bool 'Kermit' 				  RALINK_UPGRADE_BY_SERIAL n
bool "USB Recovery" 			  USB_RECOVERY_SUPPORT  n

##################################################################################################
comment "GPIO pins (-1 mean unused)"

int  'BTN Reset GPIO'		GPIO_BTN_RESET		-1
int  'BTN WPS GPIO'			GPIO_BTN_WPS		-1
int  'BTN Misc #1 GPIO'		GPIO_BTN_WLTOG		-1
int  'BTN Misc #2 GPIO'		GPIO_BTN_ROUTER		-1
bool 'LED Pins Inverted'	GPIO_LED_INVERTED	n
int  'LED All GPIO'			GPIO_LED_ALL		-1
int  'LED Init1 GPIO'		GPIO_LED_INIT1		-1
int  'LED Init2 GPIO'		GPIO_LED_INIT2		-1
int  'LED Init3 GPIO'		GPIO_LED_INIT3		-1
int  'LED Init4 GPIO'		GPIO_LED_INIT4		-1
int  'LED Init5 GPIO'		GPIO_LED_INIT5		-1
int  'LED Init6 GPIO'		GPIO_LED_INIT6		-1
int  'LED Init7 GPIO'		GPIO_LED_INIT7		-1
int  'LED Init8 GPIO'		GPIO_LED_INIT8		-1
int  'LED Alert1 GPIO'		GPIO_LED_ALERT1		-1
int  'LED Alert2 GPIO'		GPIO_LED_ALERT2		-1
int  'LED Alert3 GPIO'		GPIO_LED_ALERT3		-1
int  'LED Alert4 GPIO'		GPIO_LED_ALERT4		-1
int  'LED Power GPIO'		GPIO_LED_POWER		-1
int  'LED WAN GPIO'		GPIO_LED_WAN		-1
int  'LED WPS GPIO'		GPIO_LED_WPS		-1
int  'USB #1 5V Power GPIO'	GPIO_USB_POWER		-1
int  'USB #2 5V Power GPIO'	GPIO_USB_POWER2		-1
int  'Reset iNIC GPIO'		GPIO_RST_INIC		-1
```
